## conf/beaglev-uboot-fit-image.its
```
/dts-v1/;

/ {
        description = "U-boot FIT image for BeagleV Beta";
        #address-cells = <2>;

        images {
                vmlinux {
                        description = "vmlinux";
                        data = /incbin/("../work/deploy/5.10.6-riscv64-x6.Image");
                        type = "kernel";
                        arch = "riscv";
                        os = "linux";
                        load = <0x0 0x80200000>;
                        entry = <0x0 0x80200000>;
                        compression = "none";
                };

                fdt {
                        data = /incbin/("../work/HiFive_U-Boot/arch/riscv/dts/starfive_vic7100_evb.dtb");
                        type = "flat_dt";
                        arch = "riscv";
                        load = <0x0 0x86000000>;
                        compression = "none";
                        hash-1 {
                                algo = "sha256";
                        };
                };
        };

        configurations {
                default = "config-1";

                config-1 {
                        description = "BeagleV Beta with opensbi";
                        kernel = "vmlinux";
                        fdt = "fdt";
                };
        };
};
```

## conf/staging/uboot_fit_image_visionfive_v1_template.its
```
/dts-v1/;

/ {
	description = "U-boot FIT image for StarFive VisionFive";
	#address-cells = <2>;

	images {
		vmlinux {
			description = "vmlinux";
			data = /incbin/(@@CONFIG_FIT_VMLINUX_PATH@@);
			type = "kernel";
			arch = "riscv";
			os = "linux";
			load = <0x0 0x80200000>;
			entry = <0x0 0x80200000>;
			compression = "none";
		};

		ramdisk {
			description = "initramfs";
			data = /incbin/(@@CONFIG_FIT_INITRAMFS_PATH@@);
			type = "ramdisk";
			arch = "riscv";
			os = "linux";
			load = <0x0 0x86100000>;
			compression = "none";
			hash-1 {
				algo = "sha256";
			};
		};

		fdt {
			data = /incbin/(@@CONFIG_FIT_DTB_PATH@@);
			type = "flat_dt";
			arch = "riscv";
			load = <0x0 0x86000000>;
			compression = "none";
			hash-1 {
				algo = "sha256";
			};
		};
	};

	configurations {
		default = "config-1";

		config-1 {
			description = "StarFive VisionFive with OpenSBI";
			kernel = "vmlinux";
			fdt = "fdt";
			loadables = "ramdisk";
		};
	};
};
```

## scripts/staging/Kconfig
```kconfig
mainmenu "freelight-u-sdk main configuration"

source "scripts/staging/env/Kconfig"

source "scripts/staging/components/Kconfig"

source "scripts/staging/boards/Kconfig"
```

## scripts/staging/boards/Kconfig
```kconfig
menu "Development boards selection"

choice BOARD_SELECTION
	bool "Development boards selection"
	default VISIONFIVE_V1

config VISIONFIVE_V1
	bool "StarFive VisionFive V1 (StarFive JH7100)"

endchoice

config CONFIG_FILE
	string "config file name for target board"
	default "visionfive_v1" if VISIONFIVE_V1

endmenu
```

## scripts/staging/boards/visionfive_v1/Kconfig
```kconfig
mainmenu "StarFive VisionFive V1 build configuration"

config BOARD_SUBFIX
	string "the subfix of sourcecode and install dir"
	default "_visionfive_v1"

source "scripts/staging/boards/visionfive_v1/Kconfig.u-boot"

source "scripts/staging/boards/visionfive_v1/Kconfig.opensbi"

source "scripts/staging/boards/visionfive_v1/Kconfig.linux"

source "scripts/staging/boards/visionfive_v1/Kconfig.fit"
```

## scripts/staging/boards/visionfive_v1/Kconfig.fit
```kconfig
menu "FIT Image build configuration"

config FIT_VMLINUX_PATH
	string "Pre-build vmlinux Bin path"
	default "../../../output/kernle/linux_visionfive_v1/boot/vmlinuz"

config FIT_INITRAMFS_PATH
	string "Pre-build initramfs path"
	default "../../../output/dirstro/minimal/initramfs.cpio.gz"

config FIT_DTB_PATH
	string "Pre-build device tree blob(DTB) path"
	default "../../../output/kernle/linux_visionfive_v1/boot/dtb/starfive/jh7100-starfive-visionfive-v1.dtb"

endmenu
```

## scripts/staging/boards/visionfive_v1/Kconfig.image
```kconfig
# SPDX-License-Identifier: GPL-2.0

menu "SD/flash Image build configuration"

config VISIONFIVE_V1_UENV_PATH
	string "Pre-build uEnv.txt file path"
	default "../../prebuild/image_visionfive_v1/uEnv.txt"

config VISIONFIVE_V1_ROOTFS_IMAGE_PATH
	string "Pre-build rootfs image(ext) path"
	default "../../prebuild/image_visionfive_v1/test.ext4"

config VISIONFIVE_V1_BOOT_START
	int "boot partition(vfat) start sector( 512 B/sector ) number."
	default 4096

config VISIONFIVE_V1_BOOT_SECTORS
	int "boot partition(vfat) size(in sectors)."
	default 466943

config VISIONFIVE_V1_BOOTLOADER_START
	int "bootloader partition(raw) start sector( 512 B/sector ) number."
	default 471040

config VISIONFIVE_V1_BOOTLOADER_SECTORS
	int "bootloader partition(raw) size(in sectors)."
	default 2047

config VISIONFIVE_V1_ROOTFS_START
	int "rootfs partition(ext4) start sector( 512 B/sector ) number."
	default 475136

config VISIONFIVE_V1_SD_DEV
	string "SD card device node in /dev/, like sdg."
	default sdg

endmenu
```

## scripts/staging/boards/visionfive_v1/Kconfig.linux
```kconfig
menu "Linux kernel build configuration"

choice LINUX_GIT_REPO
	bool "Build choice"

config LINUX_GIT_REPO_R
	bool "Build from Remote REPO"

config LINUX_GIT_REPO_L
	bool "Build from local branch or commit"

endchoice

if LINUX_GIT_REPO_R

config LINUX_GIT_REMOTE
	string "Linux Remote REPO name"
	default "origin"

config LINUX_GIT_RBRANCH
	string "The branch we will use in Linux Remote REPO"
	default "visionfive"

endif

if LINUX_GIT_REPO_L

config LINUX_GIT_LBRANCH
	string "The branch/commit we will use in local REPO"
	default "visionfive"

endif

config LINUX_BUILD_IN_TMPFS
	bool "Build Linux kernel in tmpfs(in RAM)"
	default n

config LINUX_BUILD_TARGET
	string "Linux kernel defconfig name"
	default "starfive_jh7100_fedora"

config LINUX_INSTALL_SUDO
	bool "Install Linux with sudo"
	default n

config LINUX_INSTALL_PATH
	string "Linux kernel Image/vmlinuz... install path"
	default "rootfs/boot"

config LINUX_INSTALL_MOD_PATH
	string "Linux kernel modules install path"
	default "rootfs"

config LINUX_INSTALL_DTBS_PATH
	string "Linux kernel dtbs install path"
	default "rootfs/dtb"

endmenu
```

## scripts/staging/boards/visionfive_v1/Kconfig.opensbi
```kconfig
menu "OpenSBI build configuration"

choice OPENSBI_GIT_REPO
	bool "Build choice"

config OPENSBI_GIT_REPO_R
	bool "Build from Remote REPO"

config OPENSBI_GIT_REPO_L
	bool "Build from local branch or commit"

endchoice

if OPENSBI_GIT_REPO_R

config OPENSBI_GIT_REMOTE
	string "OpenSBI Remote REPO name"
	default "origin"

config OPENSBI_GIT_RBRANCH
	string "The branch we will use in OpenSBI Remote REPO"
	default "master"

endif

if OPENSBI_GIT_REPO_L

config OPENSBI_GIT_LBRANCH
	string "The branch/commit we will use in local REPO"
	default "master"

endif


choice OPENSBI_PLATFORM
	bool "platform choice"
	default OPENSBI_PLATFORM_GENERIC

config OPENSBI_PLATFORM_GENERIC
	bool "Build generic platform"

config OPENSBI_PLATFORM_SOC
	bool "Build platform/vendor/<board|soc>"

endchoice

config OPENSBI_BUILD_IN_TMPFS
	bool "Build OpenSBI in tmpfs(in RAM)"
	default n

config OPENSBI_BUILD_PLATFORM
	string "Specifies the platform which will be built"
	default "starfive/jh7100" if OPENSBI_PLATFORM_SOC
	default "generic" if OPENSBI_PLATFORM_GENERIC

config OPENSBI_BUILD_ARGS
	string "Specifies the build arguments"
	default "BUILD_INFO=y"

config OPENSBI_PREBUILD_UBOOT_BIN
	string "Pre-build U-boot Bin path"
	default "../../../output/firmware/u-boot_visionfive_v1/u-boot.bin"

config OPENSBI_PREBUILD_DTB
	string "Pre-build dtb path"
	default "../../../output/firmware/u-boot_visionfive_v1/u-boot.dtb"

endmenu
```

## scripts/staging/boards/visionfive_v1/Kconfig.u-boot
```kconfig
menu "U-boot build configuration"

choice UBOOT_GIT_REPO
	bool "Build choice"

config UBOOT_GIT_REPO_R
	bool "Build from Remote REPO"

config UBOOT_GIT_REPO_L
	bool "Build from local branch or commit"

endchoice

if UBOOT_GIT_REPO_R

config UBOOT_GIT_REMOTE
	string "U-Boot Remote REPO name"
	default "origin"

config UBOOT_GIT_RBRANCH
	string "The branch we will use in U-Boot Remote REPO"
	default "JH7100_upstream"

endif

if UBOOT_GIT_REPO_L

config UBOOT_GIT_LBRANCH
	string "The branch/commit we will use in local REPO"
	default "JH7100_upstream"

endif

config UBOOT_BUILD_IN_TMPFS
	bool "Build U-Boot in tmpfs(in RAM)"
	default n

config UBOOT_BUILD_TARGET
	string "The target board we will build for"
	default "starfive_jh7100_visionfive_smode"

endmenu
```

## scripts/staging/components/Kconfig
```kconfig
menu "Software components' REPO configuration"

config UBOOT_REPO_PATH
	string "external U-Boot REPO"
	default "src/firmware/u-boot"

config LINUX_REPO_PATH
	string "external Linux kernel REPO"
	default "src/kernel/linux"

config OPENSBI_REPO_PATH
	string "external OpenSBI REPO"
	default "src/firmware/opensbi"

endmenu
```

## scripts/staging/env/Kconfig
```kconfig
menu "SDK build environment configuration"

config BUILD_BUILDROOT_CROSS_COMPILE
	bool "MUST build the corss compiler from buildroot"
	default n

choice CROSS_COMPILE_SELECTION
	bool "Cross compiler selection"
	default WITH_SYSTEM_CROSS_COMPILE

config WITH_SYSTEM_CROSS_COMPILE
	bool "Corss compiler in the distro"

config WITH_EXTERNAL_CROSS_COMPILE
	bool "External corss compiler"

endchoice

if WITH_SYSTEM_CROSS_COMPILE

config SYSTEM_CROSS_COMPILE
	string "The corss compiler prefix"
	default "riscv64-linux-gnu-"

endif

if WITH_EXTERNAL_CROSS_COMPILE

config EXTERNAL_CROSS_COMPILE_DIR
	string "The external corss compiler directory/path"
	default "/usr/bin"

config EXTERNAL_CROSS_COMPILE
	string "The external corss compiler prefix"
	default "riscv64-linux-gnu-"

endif

config CUSTOMIZE_BUILD_JOBS
	bool "customize the number of jobs to run simultaneously in make command"
	default n

if CUSTOMIZE_BUILD_JOBS

config BUILD_JOBS_N
	int "Specifies the number of jobs (commands) to run simultaneously."
	default 4

endif

endmenu
```
